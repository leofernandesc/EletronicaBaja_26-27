## components/datalogger/Kconfig.projbuild
```kconfig
menu "Configurações do módulo de cartão SD SPI"

    config MOUNT_POINT
        string "Ponto de montagem (mount point)"
        default "/sdcard"

	config PIN_CLK
		int "Número do pino GPIO CLK"
		default 18

	config PIN_CS
		int "Número do pino GPIO CS"
		default 5

	config PIN_MISO
		int "Número do pino GPIO MISO"
		default 19

	config PIN_MOSI
		int "Número do pino GPIO MOSI"
		default 23
endmenu
```

## components/gps/Kconfig.projbuild
```kconfig
menu "Configurações do módulo GPS (NMEA)"

    config NMEA_PARSER_UART_RXD
        int "Pino GPIO de RX do GPS"
        default 16
        help
            Pino de entrada usado para receber os dados NMEA do módulo GPS.
            GPIO34 é input-only no ESP32, evitando conflito com pinos de saída, antes estava default GPIO5, dando conflito.

    config NMEA_PARSER_UART_BAUD_RATE
        int "Baud rate da UART do GPS"
        range 1200 921600
        default 9600
        help
            Taxa de transmissão da UART usada para comunicação com o modulo GPS.
            
    config NMEA_PARSER_RING_BUFFER_SIZE
        int "Tamanho do buffer circular da UART"
        default 1024

    config NMEA_PARSER_TASK_STACK_SIZE
        int "Tamanho da stack da task do parser GPS"
        default 3072

    config NMEA_PARSER_TASK_PRIORITY
        int "Prioridade da task do parser GPS"
        default 2

    menu "Sentenças NMEA suportadas"
        config NMEA_STATEMENT_GGA
            bool "GGA"
            default y
            help
                Enabling this option will parse the following parameter from GGA statement:

                - Latitude, Longitude, Altitude;
                - Number of satellites in use, fix status (no fix, GPS, DGPS), UTC time;

        config NMEA_STATEMENT_GSA
            bool "GSA"
            default y
            help
                Enabling this option will parse the following parameter from GSA statement:

                - Position/Vertical/Horizontal dilution of precision;
                - Fix mode (no fix, 2D, 3D fix);
                - IDs of satellites in use;

        config NMEA_STATEMENT_GSV
            bool "GSV"
            default y
            help
                Enabling this option will parse the following parameter from GSV statement:

                - Number of satellites in view;
                - Optional details of each satellite in view;

        config NMEA_STATEMENT_RMC
            bool "RMC"
            default y
            help
                Enabling this option will parse the following parameter from RMC statement:

                - Validity of GPS signal;
                - Ground speed (knots) and course over ground (degrees);
                - Magnetic variation;
                - UTC date;

        config NMEA_STATEMENT_GLL
            bool "GLL"
            default y
            help
                Enabling this option will parse the following parameter from GLL statement:

                - Latitude, Longitude;
                - UTC time;

        config NMEA_STATEMENT_VTG
            bool "VTG"
            default y
            help
                Enabling this option will parse the following parameter from VTG statement:

                - Ground speed (knots, km/h) and course over ground (degrees);
                - Magnetic variation;
                
    endmenu

endmenu
```

## components/speed_sensor/Kconfig.projbuild
```kconfig
menu "Speed sensor (first instance in main)"
    config SPEED_SENSOR_GPIO
        int "Pulse input GPIO"
        range 0 39
        default 27
        help
            Use an unassigned GPIO and an externally conditioned digital signal.
            GPIO27 is only a software default, not a verified board connection.

    config SPEED_SENSOR_DISTANCE_PER_PULSE_UM
        int "Vehicle travel per pulse (micrometres; 0 = uncalibrated)"
        range 0 2147483647
        default 0
        help
            Wheel circumference / (sensor pulses per shaft revolution *
            shaft revolutions per wheel revolution), expressed in micrometres.
            Zero keeps vehicle speed unavailable while pulses are captured.

    config SPEED_SENSOR_STOP_TIMEOUT_MS
        int "No-pulse timeout before reporting zero (milliseconds)"
        range 1 2147483647
        default 1000

    config SPEED_SENSOR_MIN_PULSE_INTERVAL_US
        int "Reject intervals shorter than this (microseconds; 0 = disabled)"
        range 0 2147483647
        default 0
        help
            Must be smaller than the stop timeout and any legitimate pulse
            interval at maximum speed. This is not electrical signal conditioning.

    config SPEED_SENSOR_FALLING_EDGE
        bool "Count falling edges instead of rising edges"
        default n
endmenu
```
